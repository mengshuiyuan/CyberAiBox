## main/Kconfig.projbuild
```kconfig
menu "Xiaozhi Assistant"

config OTA_URL
    string "Default OTA URL"
    default "https://api.tenclass.net/xiaozhi/ota/"
    help
        The application will access this URL to check for new firmwares and server address.

choice
    prompt "Flash Assets"
    default FLASH_DEFAULT_ASSETS
    help
        Select the assets to flash.

    config FLASH_NONE_ASSETS
        bool "Do not flash assets"
    config FLASH_DEFAULT_ASSETS
        bool "Flash Default Assets"
    config FLASH_CUSTOM_ASSETS
        bool "Flash Custom Assets"
endchoice

config CUSTOM_ASSETS_FILE
    depends on FLASH_CUSTOM_ASSETS
    string "Custom Assets File"
    default "assets.bin"
    help
        The custom assets file to flash.
        It can be a local file relative to the project directory or a remote url.

choice
    prompt "Default Language"
    default LANGUAGE_ZH_CN
    help
        Select device display language

    config LANGUAGE_ZH_CN
        bool "Chinese"
    config LANGUAGE_ZH_TW
        bool "Chinese Traditional"
    config LANGUAGE_EN_US
        bool "English"
    config LANGUAGE_JA_JP
        bool "Japanese"
    config LANGUAGE_KO_KR
        bool "Korean"
    config LANGUAGE_VI_VN
        bool "Vietnamese"
    config LANGUAGE_TH_TH
        bool "Thai"
    config LANGUAGE_DE_DE
        bool "German"
    config LANGUAGE_FR_FR
        bool "French"
    config LANGUAGE_ES_ES
        bool "Spanish"
    config LANGUAGE_IT_IT
        bool "Italian"
    config LANGUAGE_RU_RU
        bool "Russian"
    config LANGUAGE_AR_SA
        bool "Arabic"
    config LANGUAGE_HI_IN
        bool "Hindi"
    config LANGUAGE_PT_PT
        bool "Portuguese"
    config LANGUAGE_PL_PL
        bool "Polish"
    config LANGUAGE_CS_CZ
        bool "Czech"
    config LANGUAGE_FI_FI
        bool "Finnish"
    config LANGUAGE_TR_TR
        bool "Turkish"
    config LANGUAGE_ID_ID
        bool "Indonesian"
    config LANGUAGE_UK_UA
        bool "Ukrainian"
    config LANGUAGE_RO_RO
        bool "Romanian"
endchoice

choice BOARD_TYPE
    prompt "Board Type"
    default BOARD_TYPE_DUAL_SCREEN_BOX_CYBERAI_4G
    help
        Board type. 开发板类型
    config BOARD_TYPE_DUAL_SCREEN_BOX_CYBERAI_WIFI
        bool "0.71寸-双目盒子WIFI_中文"
        depends on IDF_TARGET_ESP32S3
        depends on LANGUAGE_ZH_CN
    config BOARD_TYPE_DUAL_SCREEN_BOX_CYBERAI_WIFI_EN
        bool "0.71寸-双目盒子WIFI_英语"
        depends on IDF_TARGET_ESP32S3
        depends on LANGUAGE_EN_US
    config BOARD_TYPE_DUAL_SCREEN_BOX_CYBERAI_WIFI_RU
        bool "0.71寸-双目盒子WIFI_俄语"
        depends on IDF_TARGET_ESP32S3
        depends on LANGUAGE_RU_RU
    config BOARD_TYPE_DUAL_SCREEN_BOX_CYBERAI_4G
        bool "0.71寸-双目盒子4G-中文"
        depends on IDF_TARGET_ESP32S3
        depends on LANGUAGE_ZH_CN
    config BOARD_TYPE_DUAL_SCREEN_BOX_CYBERAI_4G_EN
        bool "0.71寸-双目盒子4G-英语"
        depends on IDF_TARGET_ESP32S3
        depends on LANGUAGE_EN_US
    config BOARD_TYPE_DUAL_SCREEN_BOX_CYBERAI_4G_RU
        bool "0.71寸-双目盒子4G-俄语"
        depends on IDF_TARGET_ESP32S3
        depends on LANGUAGE_RU_RU
    config BOARD_TYPE_LARGE_DUAL_SCREEN_BOX_CYBERAI_4G
        bool "1.28寸-双目盒子4G-中文"
        depends on IDF_TARGET_ESP32S3
        depends on LANGUAGE_ZH_CN
    config BOARD_TYPE_LARGE_DUAL_SCREEN_BOX_CYBERAI_WIFI
        bool "1.28寸-双目盒子WIFI-中文"
        depends on IDF_TARGET_ESP32S3
        depends on LANGUAGE_ZH_CN    

    
endchoice

choice DISPLAY_STYLE
    prompt "Select display style"
    default USE_DEFAULT_MESSAGE_STYLE
    help
        Select display style for Xiaozhi device

    config USE_DEFAULT_MESSAGE_STYLE
        bool "Enable default message style"

    config USE_WECHAT_MESSAGE_STYLE
        bool "Enable WeChat Message Style"

    config USE_EMOTE_MESSAGE_STYLE
        bool "Emote animation style"
        depends on BOARD_TYPE_DUAL_SCREEN_BOX_CYBERAI_WIFI || BOARD_TYPE_DUAL_SCREEN_BOX_CYBERAI_WIFI_EN ||BOARD_TYPE_DUAL_SCREEN_BOX_CYBERAI_WIFI_RU ||BOARD_TYPE_DUAL_SCREEN_BOX_CYBERAI_4G ||BOARD_TYPE_DUAL_SCREEN_BOX_CYBERAI_4G_EN ||BOARD_TYPE_DUAL_SCREEN_BOX_CYBERAI_4G_RU ||BOARD_TYPE_LARGE_DUAL_SCREEN_BOX_CYBERAI_WIFI ||BOARD_TYPE_LARGE_DUAL_SCREEN_BOX_CYBERAI_4G
endchoice

choice WAKE_WORD_TYPE
    prompt "Wake Word Implementation Type"
    default USE_AFE_WAKE_WORD if (IDF_TARGET_ESP32S3 || IDF_TARGET_ESP32P4) && SPIRAM
    default WAKE_WORD_DISABLED
    help
        Choose the type of wake word implementation to use

    config WAKE_WORD_DISABLED
        bool "Disabled"
        help
            Disable wake word detection

    config USE_ESP_WAKE_WORD
        bool "Wakenet model without AFE"
        depends on IDF_TARGET_ESP32C3 || IDF_TARGET_ESP32C5 || IDF_TARGET_ESP32C6 || (IDF_TARGET_ESP32 && SPIRAM)
        help
            Support ESP32 C3、ESP32 C5 与 ESP32 C6, and (ESP32 with PSRAM)

    config USE_AFE_WAKE_WORD
        bool "Wakenet model with AFE"
        depends on (IDF_TARGET_ESP32S3 || IDF_TARGET_ESP32P4) && SPIRAM
        help
            Support AEC if available, requires ESP32 S3 and PSRAM

    config USE_CUSTOM_WAKE_WORD
        bool "Multinet model (Custom Wake Word)"
        depends on (IDF_TARGET_ESP32S3 || IDF_TARGET_ESP32P4) && SPIRAM
        help
            Requires ESP32 S3 and PSRAM

endchoice

config CUSTOM_WAKE_WORD
    string "Custom Wake Word"
    default "xiao tu dou"
    depends on USE_CUSTOM_WAKE_WORD
    help
        Custom Wake Word, use pinyin for Chinese, separated by spaces

config CUSTOM_WAKE_WORD_DISPLAY
    string "Custom Wake Word Display"
    default "小土豆"
    depends on USE_CUSTOM_WAKE_WORD
    help
        Greeting sent to the server after wake word detection

config CUSTOM_WAKE_WORD_THRESHOLD
    int "Custom Wake Word Threshold (%)"
    default 20
    range 1 99
    depends on USE_CUSTOM_WAKE_WORD
    help
        Custom Wake Word Threshold, range 1-99, the smaller the more sensitive, default 20

config SEND_WAKE_WORD_DATA
    bool "Send Wake Word Data"
    default y
    depends on USE_AFE_WAKE_WORD || USE_CUSTOM_WAKE_WORD
    help
        Send wake word data to the server as the first message of the conversation and wait for response
        
config USE_AUDIO_PROCESSOR
    bool "Enable Audio Noise Reduction"
    default y
    depends on (IDF_TARGET_ESP32S3 || IDF_TARGET_ESP32P4) && SPIRAM
    help
        Requires ESP32 S3 and PSRAM

config USE_DEVICE_AEC
    bool "Enable Device-Side AEC"
    default n
        depends on USE_AUDIO_PROCESSOR && (BOARD_TYPE_DUAL_SCREEN_BOX_CYBERAI_WIFI || BOARD_TYPE_DUAL_SCREEN_BOX_CYBERAI_WIFI_EN ||BOARD_TYPE_DUAL_SCREEN_BOX_CYBERAI_WIFI_RU || BOARD_TYPE_DUAL_SCREEN_BOX_CYBERAI_4G ||BOARD_TYPE_DUAL_SCREEN_BOX_CYBERAI_4G_EN ||BOARD_TYPE_DUAL_SCREEN_BOX_CYBERAI_4G_RU ||BOARD_TYPE_LARGE_DUAL_SCREEN_BOX_CYBERAI_WIFI ||BOARD_TYPE_LARGE_DUAL_SCREEN_BOX_CYBERAI_4G)
    help
        To work properly, device-side AEC requires a clean output reference path from the speaker signal and physical acoustic isolation between the microphone and speaker.

config USE_SERVER_AEC
    bool "Enable Server-Side AEC (Unstable)"
    default n
    depends on USE_AUDIO_PROCESSOR
    help
        To work perperly, server-side AEC requires server support

config USE_AUDIO_DEBUGGER
    bool "Enable Audio Debugger"
    default n
    help
        Enable audio debugger, send audio data through UDP to the host machine

config AUDIO_DEBUG_UDP_SERVER
    string "Audio Debug UDP Server Address"
    default "192.168.2.100:8000"
    depends on USE_AUDIO_DEBUGGER
    help
        UDP server address, format: IP:PORT, used to receive audio debugging data

config USE_ACOUSTIC_WIFI_PROVISIONING
    bool "Enable Acoustic WiFi Provisioning"
    default n
    help
        Enable acoustic WiFi provisioning, use audio signal to transmit WiFi configuration data

config RECEIVE_CUSTOM_MESSAGE
    bool "Enable Custom Message Reception"
    default n
    help
        Enable custom message reception, allow the device to receive custom messages from the server (preferably through the MQTT protocol)

menu TAIJIPAI_S3_CONFIG
    depends on BOARD_TYPE_ESP32S3_Taiji_Pi
    choice I2S_TYPE_TAIJIPI_S3
        prompt "taiji-pi-S3 I2S Type"
        default TAIJIPAI_I2S_TYPE_STD
        help
            I2S 类型选择
        config TAIJIPAI_I2S_TYPE_STD
            bool "I2S Type STD"
        config TAIJIPAI_I2S_TYPE_PDM
            bool "I2S Type PDM"
    endchoice

    config I2S_USE_2SLOT
    bool "Enable I2S 2 Slot"
    default n
    help
        启动双声道
endmenu

endmenu
```
